## board/advantech/mx6qimsse01/Kconfig
```kconfig
if TARGET_MX6QIMSSE01

config SYS_BOARD
	default "mx6qimsse01"

config SYS_VENDOR
	default "advantech"

config SYS_CONFIG_NAME
	default "mx6qimsse01"

endif
```

## configs/mx6qimsse01_defconfig
```kconfig
CONFIG_ARM=y
CONFIG_ARCH_MX6=y
CONFIG_TARGET_MX6QIMSSE01=y
CONFIG_SYS_EXTRA_OPTIONS="IMX_CONFIG=board/advantech/mx6qimsse01/mx6qimsse01.cfg,MX6Q,SYS_USE_SPINOR"
CONFIG_CMD_GPIO=y
```
